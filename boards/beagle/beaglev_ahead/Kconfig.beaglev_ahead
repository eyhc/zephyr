## boards/beagle/beaglev_ahead/Kconfig.beaglev_ahead
```kconfig
# SPDX-FileCopyrightText: Copyright The Zephyr Project Contributors
# SPDX-License-Identifier: Apache-2.0

config BOARD_BEAGLEV_AHEAD
	select SOC_TH1520
```

## boards/beagle/beaglev_ahead/beaglev_ahead_defconfig
```kconfig
# SPDX-FileCopyrightText: Copyright The Zephyr Project Contributors
# SPDX-License-Identifier: Apache-2.0

CONFIG_CONSOLE=y
CONFIG_SERIAL=y
CONFIG_UART_CONSOLE=y
CONFIG_XIP=n
CONFIG_INCLUDE_RESET_VECTOR=y
CONFIG_SRAM_BASE_ADDRESS=0x40200000
CONFIG_SRAM_SIZE=1048576
CONFIG_SYS_CLOCK_EXISTS=n
CONFIG_RISCV_MACHINE_TIMER=n
```

## boards/beagle/beaglev_ahead/board.yml
```yaml
# SPDX-FileCopyrightText: Copyright The Zephyr Project Contributors
# SPDX-License-Identifier: Apache-2.0

board:
  name: beaglev_ahead
  full_name: BeagleV®-Ahead
  vendor: beagle
  socs:
  - name: th1520
```

## boards/muselab/nanoCH57x/Kconfig.nanoCH57x
```kconfig
# Copyright (c) 2026 SMILE (smile.eu)
# SPDX-License-Identifier: Apache-2.0

config BOARD_NANOCH57X
	select SOC_CH570 if BOARD_NANOCH57X_CH570
	select SOC_CH572 if BOARD_NANOCH57X_CH572
```

## boards/waveshare/esp32h2_zero/Kconfig.esp32h2_zero
```kconfig
# Copyright (c) 2026 Smile (smaile.eu)
# SPDX-License-Identifier: Apache-2.0

config BOARD_ESP32H2_ZERO
	select SOC_ESP32_H2_MINI_H4
```

## boards/waveshare/esp32h2_zero/board.yml
```yaml
board:
  name: esp32h2_zero
  full_name: ESP32-H2-Zero
  vendor: waveshare
  socs:
  - name: esp32h2
```

## boards/waveshare/esp32p4_wifi6_devkit/Kconfig
```kconfig
# Copyright (c) 2026 Smile (smile.eu)
# SPDX-License-Identifier: Apache-2.0

config HEAP_MEM_POOL_ADD_SIZE_BOARD
	int
	default 4096 if BOARD_ESP32P4_WIFI6_DEVKIT_ESP32P4_HPCORE
	default 256 if BOARD_ESP32P4_WIFI6_DEVKIT_ESP32P4_LPCORE
```

## boards/waveshare/esp32p4_wifi6_devkit/Kconfig.defconfig
```kconfig
# Copyright (c) 2026 Smile (smile.eu)
# SPDX-License-Identifier: Apache-2.0

if BOARD_ESP32P4_WIFI6_DEVKIT_ESP32P4_HPCORE

configdefault NET_L2_ETHERNET
	default y

endif # BOARD_ESP32P4_WIFI6_DEVKIT_ESP32P4_HPCORE
```

## boards/waveshare/esp32p4_wifi6_devkit/Kconfig.esp32p4_wifi6_devkit
```kconfig
# Copyright (c) 2026 Smile (smile.eu)
# SPDX-License-Identifier: Apache-2.0

config BOARD_ESP32P4_WIFI6_DEVKIT
	select SOC_ESP32P4_HPCORE if BOARD_ESP32P4_WIFI6_DEVKIT_ESP32P4_HPCORE
	select SOC_ESP32P4_LPCORE if BOARD_ESP32P4_WIFI6_DEVKIT_ESP32P4_LPCORE
	select SOC_ESP32P4_REV_1_3
```

## boards/waveshare/esp32p4_wifi6_devkit/board.yml
```yaml
board:
  name: esp32p4_wifi6_devkit
  full_name: ESP32-P4-WiFi6-DEV-KIT
  vendor: waveshare
  socs:
  - name: esp32p4
```

## drivers/gpio/Kconfig.wch_ch5xx
```kconfig
# Copyright (c) 2026 SMILE (smile.eu)
# SPDX-License-Identifier: Apache-2.0

config GPIO_WCH_CH5XX
	bool "WCH CH5xx GPIO driver"
	depends on DT_HAS_WCH_GPIO_CH5XX_ENABLED
	default y

config GPIO_WCH_CH5XX_INTERRUPTS
	bool "Interrupt support"
	depends on GPIO_WCH_CH5XX
	depends on DT_HAS_WCH_PFIC_ENABLED
	default y
	help
	  Support triggering an interrupt on pin change.

config GPIO_WCH_CH5XX_SUPPORT_PORTB
	bool "GPIO Port B support"
	depends on GPIO_WCH_CH5XX
	depends on SOC_HAS_GPIO_PORTB
	default n
	help
	  Enable GPIO Port B if available on the SoC.
```

## drivers/i2c/Kconfig.wch_ch5xx
```kconfig
# Copyright (c) 2026 Smile (smile.eu)
# SPDX-License-Identifier: Apache-2.0

config I2C_WCH_CH5XX
	bool "WCH CH5XX I2C driver"
	default y
	depends on DT_HAS_WCH_CH5XX_I2C_ENABLED
	select PINCTRL
	help
	  Enable I2C support on WCH CH5XX platforms

config I2C_WCH_CH5XX_XFER_TIMEOUT_MS
	int "Set the transfer timeout in milliseconds"
	depends on I2C_WCH_CH5XX
	default 500
```

## drivers/pinctrl/Kconfig.wch_ch570
```kconfig
# Copyright (c) 2026 SMILE (smile.eu)
# SPDX-License-Identifier: Apache-2.0

config PINCTRL_WCH_CH570
	bool "WCH pin controller driver"
	default y
	depends on DT_HAS_WCH_CH570_PINCTRL_ENABLED
	help
	  WCH CH570-CH572 pin controller driver.
```

## drivers/pwm/Kconfig.wch_ch5xx
```kconfig
# SPDX-FileCopyrightText: 2026 SMILE (smile.eu)
# SPDX-License-Identifier: Apache-2.0

config PWM_WCH_CH5XX
	bool "WCH CH5xx PWM"
	default y
	depends on DT_HAS_WCH_CH5XX_PWM_ENABLED
	select PINCTRL
	help
	  PWM driver for the WCH CH5xx series
```

## drivers/serial/Kconfig.wch_uart
```kconfig
# Copyright (c) 2026 SMILE (smile.eu)
# SPDX-License-Identifier: Apache-2.0

config UART_WCH
	bool "CH5xx UART driver"
	default y
	depends on DT_HAS_WCH_UART_ENABLED
	select SERIAL_HAS_DRIVER
	select SERIAL_SUPPORT_INTERRUPT
	select PINCTRL
	help
	  This option enables the UART driver for CH5xx SoC family.
```

## dts/bindings/clock/wch,ch570-clkctrl.yaml
```yaml
# SPDX-FileCopyrightText: 2026 SMILE (smile.eu)
# SPDX-License-Identifier: Apache-2.0

description: WCH CH570/CH572 Clock Control

compatible: "wch,ch570-clkctrl"

include: [clock-controller.yaml, base.yaml]

properties:
  "#clock-cells":
    const: 1

  clock-divider:
    default: 5
    type: int
    description: |
      Clock division factor. Valid values are 0 to 31:
        - 0: divide by 32 (maximum division)
        - 1: clock disabled
        - 2-31: divide by the corresponding value
      The resulting clock frequency must not exceed 100 MHz.

  hse-bias-current-percent:
    default: 100
    type: int
    enum:
      - 75
      - 100
      - 125
      - 150
    description: |
      Oscillator bias current as a percentage of the nominal value.

  hse-load-capacitance-pf:
    type: int
    default: 16
    enum:
      - 6
      - 8
      - 10
      - 12
      - 14
      - 16
      - 18
      - 20
    description: |
      Internal load capacitance for the external 32 MHz crystal, in pF.

clock-cells:
  - id
```

## dts/bindings/clock/wch,ch5xx-pll-clock.yaml
```yaml
# SPDX-FileCopyrightText: 2026 SMILE (smile.eu)
# SPDX-License-Identifier: Apache-2.0

description: WCH CH5xx PLL

compatible: "wch,ch5xx-pll-clock"

include: [clock-controller.yaml, base.yaml]

properties:
  "#clock-cells":
    const: 0

  clocks:
    type: phandle-array
    required: true
```

## dts/bindings/comparator/wch,ch5xx-comparator.yaml
```yaml
# Copyright (c) 2025 Microchip Technology Inc.
# SPDX-License-Identifier: Apache-2.0

title: CH5xx Comparator

description: |
  Binding for the WCH CH5xx Comparator driver.

compatible: "wch,ch5xx-comparator"

include:
  - name: base.yaml
  - name: pinctrl-device.yaml

properties:
  reg:
    required: true

  positive-mux-input:
    type: string
    enum:
      - "PA3"
      - "PA7"
    default: "PA3"
    description: |
      Positive input source selection

  negative-mux-input:
    type: string
    enum:
      - "PA2"
      - "VREF"
    default: "PA2"
    description: |
      Negative input source selection
```

## dts/bindings/gpio/wch,gpio-ch5xx.yaml
```yaml
# Copyright (c) 2026 SMILE (smile.eu)
# SPDX-License-Identifier: Apache-2.0

description: WCH CH5xx General-Purpose Input/Output (GPIO)

compatible: "wch,gpio-ch5xx"

include: [gpio-controller.yaml, base.yaml]

properties:
  reg:
    required: true

  "#gpio-cells":
    const: 2

  port:
    required: true
    type: string
    description: GPIO port
    enum:
      - "port-a"
      - "port-b"

gpio-cells:
  - pin
  - flags
```

## dts/bindings/i2c/wch,ch5xx-i2c.yaml
```yaml
# Copyright (c) 2026 SMILE (smile.eu)
# SPDX-License-Identifier: Apache-2.0

description: WCH I2C controller

compatible: "wch,ch5xx-i2c"

include: [i2c-controller.yaml, pinctrl-device.yaml]

properties:
  reg:
    required: true

  clocks:
    required: true

  clock-frequency:
    required: true

  interrupts:
    required: true

  pinctrl-0:
    required: true

  pinctrl-names:
    default: ["default"]
```

## dts/bindings/pwm/wch,ch5xx-pwm.yaml
```yaml
# SPDX-FileCopyrightText: 2026 SMILE (smile.eu)
# SPDX-License-Identifier: Apache-2.0

description: CH5xx PWM Controller Node

compatible: "wch,ch5xx-pwm"

include: [base.yaml, pwm-controller.yaml, pinctrl-device.yaml]

properties:
  "#pwm-cells":
    const: 3

  first-channel-number:
    type: int
    required: true
    description: Number of the first PWM channel exposed by this instance.

  counter-width:
    type: int
    enum:
      - 8
      - 7
      - 6
      - 16
    default: 8
    description: |
      Indicates if the PWM controller uses a 16-bit counter instead of a 8-bit counter.

  minus-one-period:
    type: boolean
    description: |
      Select the counter range for 6/7/8-bit modes.
      If present, the PWM period is: 63 cycles (6-bit)/127 cycles (7-bit)/255 cycles (8-bit)
      Otherwise, the PWM period is: 64 cycles/128 cycles/256 cycles
      Ignored when `counter-width` is 16.

  period-cycles-group0:
    type: int
    default: 65535
    description: |
      PWM period for channels sharing counter group 0 (PWM1-3) used when `counter-width` is 16.

  period-cycles-group1:
    type: int
    default: 65535
    description: |
      PWM period for channels sharing counter group 1 (PWM4-5) used when `counter-width` is 16.

  prescaler:
    type: int
    default: 1
    description: |
      Clock divider for the PWM controller between 1 and 65535.
      The PWM clock is derived from the parent clock by dividing it by this value.

pwm-cells:
  - channel
  - period
  - flags
```

## soc/thead/th1520/Kconfig
```kconfig
# SPDX-FileCopyrightText: Copyright The Zephyr Project Contributors
# SPDX-License-Identifier: Apache-2.0

config SOC_TH1520
	select RISCV
	select RISCV_PRIVILEGED
	select RISCV_HAS_PLIC
```

## soc/thead/th1520/Kconfig.defconfig
```kconfig
# SPDX-FileCopyrightText: Copyright The Zephyr Project Contributors
# SPDX-License-Identifier: Apache-2.0

if SOC_TH1520

config NUM_IRQS
    default 224

choice UART_NS16550_VARIANT
	default UART_NS16550_VARIANT_NS16750
endchoice

config 2ND_LVL_INTR_00_OFFSET
    default 11

endif # SOC_TH1520
```

## soc/thead/th1520/Kconfig.soc
```kconfig
# SPDX-FileCopyrightText: Copyright The Zephyr Project Contributors
# SPDX-License-Identifier: Apache-2.0

config SOC_TH1520
	bool

config SOC
	default "th1520" if SOC_TH1520
```

## soc/wch/ch32v/qingke_v3c/Kconfig
```kconfig
# Copyright (c) 2026 SMILE (smile.eu)
# SPDX-License-Identifier: Apache-2.0

config SOC_SERIES_QINGKE_V3C

config SOC_HAS_GPIO_PORTB
	bool "Hardware GPIO Port B support"
```
