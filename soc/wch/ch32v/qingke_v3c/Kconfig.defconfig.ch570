## soc/wch/ch32v/qingke_v3c/Kconfig.defconfig.ch570
```kconfig
# Copyright (c) 2026 SMILE (smile.eu)
# SPDX-License-Identifier: Apache-2.0

if SOC_CH570

config VECTOR_TABLE_SIZE
	default 35

config NUM_IRQS
	default 36

config SOC_HAS_GPIO_PORTB
	default n

endif # SOC_CH570
```

## soc/wch/ch32v/qingke_v3c/Kconfig.defconfig.ch572
```kconfig
# Copyright (c) 2026 SMILE (smile.eu)
# SPDX-License-Identifier: Apache-2.0

if SOC_CH572

config VECTOR_TABLE_SIZE
	default 35

config NUM_IRQS
	default 36

config SOC_HAS_GPIO_PORTB
	default n

endif # SOC_CH572
```
